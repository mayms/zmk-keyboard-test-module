#include "test.dtsi"

&default_transform { // The matrix transform for this board is 3 columns over because the left half is 3 columns wide according to the matrix.
    col-offset = <3>;
};

&kscan0 {
    col-gpios
        = <&pro_micro 14 GPIO_ACTIVE_HIGH>
        , <&pro_micro 16 GPIO_ACTIVE_HIGH>
        , <&pro_micro 10 GPIO_ACTIVE_HIGH>
        ;
};